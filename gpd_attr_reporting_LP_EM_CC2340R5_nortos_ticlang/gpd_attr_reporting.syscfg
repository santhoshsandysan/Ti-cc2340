/**
 * @cliArgs --board "/ti/boards/LP_EM_CC2340R5" --device "CC2340R5RKP" --part "Default" --package "RKP" --rtos "nortos" --product "simplelink_lowpower_f3_sdk@9.11.01.19"
 * @versions {"tool":"1.23.2+4156"}
 */

/**
 * Import the modules used in this configuration.
 */
const CCFG     = scripting.addModule("/ti/devices/CCFG");
const rfdesign = scripting.addModule("/ti/devices/radioconfig/rfdesign");
const Display  = scripting.addModule("/ti/display/Display", {}, false);
const Display1 = Display.addInstance();
const GPIO     = scripting.addModule("/ti/drivers/GPIO");
const GPIO1    = GPIO.addInstance();
const GPIO2    = GPIO.addInstance();
const GPIO3    = GPIO.addInstance();
const GPIO4    = GPIO.addInstance();
const zigbee   = scripting.addModule("/ti/zigbee/zigbee");

/**
 * Write custom configuration values to the imported modules.
 */
CCFG.ccfgTemplate.$name = "ti_devices_CCFG_CCFGCC23X0Template0";

Display1.$name      = "CONFIG_Display_0";
Display1.$hardware  = system.deviceData.board.components.XDS110UART;
Display1.enableANSI = true;
Display1.uart.$name = "CONFIG_UART2_0";

GPIO1.$hardware = system.deviceData.board.components.LED_GREEN;
GPIO1.$name     = "CONFIG_GPIO_GLED";

GPIO2.$hardware = system.deviceData.board.components.LED_RED;
GPIO2.$name     = "CONFIG_GPIO_RLED";

GPIO3.$hardware        = system.deviceData.board.components["BTN-1"];
GPIO3.$name            = "CONFIG_GPIO_BTN1";
GPIO3.pull             = "Pull Up";
GPIO3.interruptTrigger = "Falling Edge";

GPIO4.$hardware        = system.deviceData.board.components["BTN-2"];
GPIO4.$name            = "CONFIG_GPIO_BTN2";
GPIO4.pull             = "Pull Up";
GPIO4.interruptTrigger = "Falling Edge";

zigbee.deviceType         = ["gpd"];
zigbee.deviceTypeReadOnly = true;
zigbee.gpdRf.$name        = "ti_zigbee_gpd_zigbee_gpd_rf0";
zigbee.gpdRf.txPower      = 8;
zigbee.gpdNetwork.$name   = "ti_zigbee_gpd_zigbee_gpd_network0";
zigbee.gpdSecurity.$name  = "ti_zigbee_gpd_zigbee_gpd_security0";
zigbee.gpdAdvanced.$name  = "ti_zigbee_gpd_zigbee_gpd_advanced0";

const RNG       = scripting.addModule("/ti/drivers/RNG", {}, false);
RNG.rngPoolSize = 512;
scripting.suppress("This the default noise conditioning key provided by TI, which is acceptable per NIST SP 800-90B\\. However, TI recommends you change this default value to a custom random value for your product", RNG, "noiseConditioningKeyW3");

/**
 * Pinmux solution for unlocked pins/peripherals. This ensures that minor changes to the automatic solver in a future
 * version of the tool will not impact the pinmux you originally saw.  These lines can be completely deleted in order to
 * re-solve from scratch.
 */
Display1.uart.uart.$suggestSolution              = "UART0";
Display1.uart.uart.dmaTxChannel.$suggestSolution = "DMA_CH1";
Display1.uart.uart.dmaRxChannel.$suggestSolution = "DMA_CH0";
Display1.uart.uart.txPin.$suggestSolution        = "boosterpack.4";
Display1.uart.uart.rxPin.$suggestSolution        = "boosterpack.3";
GPIO1.gpioPin.$suggestSolution                   = "boosterpack.40";
GPIO2.gpioPin.$suggestSolution                   = "boosterpack.39";
GPIO3.gpioPin.$suggestSolution                   = "boosterpack.13";
GPIO4.gpioPin.$suggestSolution                   = "boosterpack.12";
